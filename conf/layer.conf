## conf/layer.conf
```bitbake
# We have a conf and classes directory, add to BBPATH
BBPATH := "${BBPATH}:${LAYERDIR}"
# We have a packages directory, add to BBFILES
BBFILES := "${BBFILES} ${LAYERDIR}/recipes-*/*/*.bb \
            ${LAYERDIR}/recipes-*/*/*.bbappend"
BBFILE_COLLECTIONS += "moyapp-1"
BBFILE_PATTERN_moyapp-1 := "^${LAYERDIR}/"
BBFILE_PRIORITY_moyapp-1 := "5"

LAYERSERIES_COMPAT_moyapp-1 = "dunfell kirkstone"
```
